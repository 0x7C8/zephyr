/*
 * Copyright (c) 2025 LTH
 *
 * SPDX-License-Identifier: Apache-2.0
 */

#include <skeleton.dtsi>
#include <freq.h>
#include <mem.h>

/ {
    soc {
        #address-cells = <1>;
        #size-cells = <1>;
        // TODO
        sram0: memory@20000000 {
            compatible = "mmio-sram";
            reg = <0x20000000 DT_SIZE_K(512)>;
        };
        dram0: memory@80000000 {
            compatible = "mmio-sram";
            reg = <0x80000000 DT_SIZE_M(1024)>;
        };
    };
};
