/*
 * Copyright (c) 2025 LTH
 *
 * SPDX-License-Identifier: Apache-2.0
 */

/dts-v1/;

#include <lth/l31core.dtsi>

/ {
    compatible = "codasip,l31core";

    chosen {
        zephyr,sram = &sram0;
        zephyr,timer = &clint;
    };
};