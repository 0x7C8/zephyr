## boards/lth/lth_l31core/Kconfig.board
```kconfig
# Copyright (c) 2025 LTH
# SPDX-License-Identifier: Apache-2.0

config BOARD_L31CORE
	bool "Board with Codasip RISC-V L31"
	depends on SOC_L31CORE
```

## boards/lth/lth_l31core/Kconfig.defconfig
```kconfig
# Copyright (c) 2025 LTH
# SPDX-License-Identifier: Apache-2.0

if BOARD_L31CORE

config BOARD
	default "lth_l31core"

endif # BOARD_L31CORE
```

## boards/lth/lth_l31core/board.yml
```yaml
board:
  name: lth_l31core
  full_name: LTH L31Core
  vendor: LTH
  socs:
  - name: codasip_l31
```

## boards/lth/lth_l31core/lth_l31core_defconfig
```kconfig
# Copyright (c) 2025 LTH
# SPDX-License-Identifier: Apache-2.0

CONFIG_SOC_CODASIP_L31=y
# CONFIG_BOARD_L31CORE=y
CONFIG_CONSOLE=y
#CONFIG_SERIAL=y
#CONFIG_UART_CONSOLE=y
CONFIG_TICKLESS_KERNEL=n
CONFIG_XIP=n
CONFIG_CLOCK_CONTROL=n
#CONFIG_HEAP_MEM_POOL_SIZE=4096
```

## boards/lth/nexys4/Kconfig.nexys4
```kconfig
# Copyright (c) 2026 Georgij Michaliutin
# SPDX-License-Identifier: Apache-2.0

config BOARD_NEXYS4
	select SOC_L31A
```

## boards/lth/nexys4/board.yml
```yaml
board:
  name: nexys4
  full_name: Nexys4 FPGA Board
  vendor: lth
  socs:
    - name: l31a
```

## boards/lth/nexys4/nexys4_defconfig
```kconfig
# Copyright (c) 2026 Georgij Michaliutin
# SPDX-License-Identifier: Apache-2.0


# No UART, disable console output
CONFIG_SERIAL=n
CONFIG_CONSOLE=n
CONFIG_PRINTK=n
CONFIG_BOOT_BANNER=n

# Minimal footprint
CONFIG_MINIMAL_LIBC=y
CONFIG_SIZE_OPTIMIZATIONS=y
#CONFIG_MAIN_STACK_SIZE=1024
#CONFIG_ISR_STACK_SIZE=512
#CONFIG_IDLE_STACK_SIZE=256

# Output format
CONFIG_BUILD_OUTPUT_BIN=y

# GPIO (TODO)
# CONFIG_GPIO=y
```

## dts/bindings/cpu/codasip,l31core.yaml
```yaml
# Copyright (c) 2025 LTH
# SPDX-License-Identifier: Apache-2.0

description: This is a representation of Codasip L31 CPU.

compatible: "codasip,l31core"

include: cpu.yaml
```

## soc/lth/codasip_l31/Kconfig
```kconfig
# Copyright (c) 2025 LTH
# SPDX-License-Identifier: Apache-2.0

config SOC_CODASIP_L31
    select RISCV
    select RISCV_PRIVILEGED
    select ATOMIC_OPERATIONS_C
    select INCLUDE_RESET_VECTOR
    select RISCV_ISA_RV32I
    select RISCV_ISA_EXT_M
    select RISCV_ISA_EXT_C
    select RISCV_ISA_EXT_ZICSR
    select RISCV_ISA_EXT_ZIFENCEI
    select RISCV_ISA_EXT_ZBA
    select RISCV_ISA_EXT_ZBB
    select RISCV_ISA_EXT_ZBC
    select RISCV_ISA_EXT_ZBS
```

## soc/lth/codasip_l31/Kconfig.soc
```kconfig
# Copyright (c) 2025 LTH
# SPDX-License-Identifier: Apache-2.0

config SOC_CODASIP_L31
    bool "Codasip L31 SoC"
    help
        Codasip L31 implementation

config SOC
    default "codasip_l31" if SOC_CODASIP_L31
```

## soc/lth/l31a/Kconfig
```kconfig
# Copyright (c) 2026 Georgij Michaliutin
# SPDX-License-Identifier: Apache-2.0

if SOC_L31A

config SOC
	default "l31a"

config SOC_FAMILY
	default "lth"

endif
```

## soc/lth/l31a/Kconfig.defconfig
```kconfig
# Copyright (c) 2026 Georgij Michaliutin
# SPDX-License-Identifier: Apache-2.0

if SOC_L31A

config SYS_CLOCK_HW_CYCLES_PER_SEC
	default 25000000

config NUM_IRQS
	default 32

config RISCV_HAS_PLIC
	default n

config XIP
	default n

endif # SOC_L31A
```

## soc/lth/l31a/Kconfig.soc
```kconfig
# Copyright (c) 2026 Georgij Michaliutin
# SPDX-License-Identifier: Apache-2.0

config SOC_L31A
	bool "LTH L31A SoC"
	select RISCV
	select RISCV_PRIVILEGED
	select INCLUDE_RESET_VECTOR

	select RISCV_ISA_RV32I
	select RISCV_ISA_EXT_M
	select RISCV_ISA_EXT_C
	select RISCV_ISA_EXT_ZICSR
	select RISCV_ISA_EXT_ZIFENCEI

	select ATOMIC_OPERATIONS_C
	select RISCV_MACHINE_TIMER


	help
	  LTH Codasip L31A: RV32IMC SoC on Nexys4 (Artix-7).
	  Peripherals: BRAM (64 KB), CLINT, GPIO (16-bit output).
	  No PLIC, no MMU, no FPU. Machine mode only.
```
